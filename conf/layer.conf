## conf/layer.conf
```bitbake
# We have a conf and classes directory, add to BBPATH
BBPATH .= ":${LAYERDIR}"

# We have recipes-* directories, add to BBFILES
BBFILES += "${LAYERDIR}/recipes-*/*/*.bb \
            ${LAYERDIR}/recipes-*/*/*.bbappend"

BBFILE_COLLECTIONS += "meta-custom-drivers"
BBFILE_PATTERN_meta-custom-drivers = "^${LAYERDIR}/"
BBFILE_PRIORITY_meta-custom-drivers = "6"

LAYERDEPENDS_meta-custom-drivers = "core"
LAYERSERIES_COMPAT_meta-custom-drivers = "mickledore"
```
